## package/micro-config-drive/Config.in
```kconfig
config BR2_PACKAGE_MICRO_CONFIG_DRIVE
	bool "micro-config-drive"
	depends on BR2_USE_WCHAR # libglib2
	depends on BR2_TOOLCHAIN_HAS_THREADS # libglib2
	depends on BR2_USE_MMU # libglib2
	select BR2_PACKAGE_LIBGLIB2
	select BR2_PACKAGE_LIBYAML
	select BR2_PACKAGE_PARTED
	select BR2_PACKAGE_UTIL_LINUX_LIBBLKID
	select BR2_PACKAGE_JSON_GLIB
	select BR2_PACKAGE_CHECK
	help
	  An alternative and small cloud-init
	  implementation in C.

	  https://github.com/clearlinux/micro-config-drive
```
